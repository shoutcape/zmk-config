## config/west.yml
```yaml
manifest:
  remotes:
      # zmk official
    - name: zmkfirmware
      url-base: https://github.com/zmkfirmware
    - name: shoutcape
      url-base: https://github.com/shoutcape
  projects:
    - name: zmk
      remote: zmkfirmware
      revision: ac7f75b8
      import: app/west.yml
    - name: nice-view-mod
      remote: shoutcape
      revision: main
  self:
    path: config
```
